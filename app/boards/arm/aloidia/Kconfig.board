## app/boards/arm/aloidia/Kconfig.board
```kconfig
#
# Copyright (c) 2023 Vincent Nguyen
# SPDX-License-Identifier: MIT
#

config BOARD_ALOIDIA_DONGLE
	bool "aloidia_dongle"
	depends on SOC_NRF52840_QIAA

config BOARD_ALOIDIA_LEFT
	bool "aloidia_left"
	depends on SOC_NRF52840_QIAA

config BOARD_ALOIDIA_RIGHT
	bool "aloidia_right"
	depends on SOC_NRF52840_QIAA
```

## app/boards/arm/aloidia/Kconfig.defconfig
```kconfig
#
# Copyright (c) 2023 Vincent Nguyen
# SPDX-License-Identifier: MIT
#

if BOARD_ALOIDIA_DONGLE

config ZMK_KEYBOARD_NAME
	default "aloidia dongle"

config ZMK_SPLIT
	default y

config ZMK_SPLIT_BLE_ROLE_CENTRAL
	default y
	
endif # BOARD_ALOIDIA_DONGLE

if BOARD_ALOIDIA_LEFT || BOARD_ALOIDIA_RIGHT

config BOARD
	default "aloidia"

config I2C
	bool
	default y

config SPI
    bool
    default y	

config MAX17048
	default y

config ZMK_DISPLAY
	select LVGL_FONT_MONTSERRAT_26

if ZMK_DISPLAY

config LS0XX_CUSTOM
	default y

config ZMK_WIDGET_WPM_STATUS
	default y if !ZMK_SPLIT || ZMK_SPLIT_ROLE_CENTRAL

config LVGL_BITS_PER_PIXEL
	default 1

choice LVGL_COLOR_DEPTH
	default LVGL_COLOR_DEPTH_1
endchoice

endif # ZMK_DISPLAY

endif # BOARD_ALOIDIA_LEFT || BOARD_ALOIDIA_RIGHT

if BOARD_ALOIDIA_LEFT || BOARD_ALOIDIA_RIGHT || BOARD_ALOIDIA_DONGLE

config ZMK_SPLIT
	default y

if USB

config USB_DEVICE_STACK
	default y	

if USB_DEVICE_STACK

config USB_NRFX
	default y

endif # USB_DEVICE_STACK

endif # USB

config BT_CTLR
	default BT

config ZMK_BLE
	default y

config ZMK_USB
	default y

endif # BOARD_ALOIDIA_LEFT || BOARD_ALOIDIA_RIGHT || BOARD_ALOIDIA_DONGLE
```

## app/boards/arm/aloidia/aloidia_dongle_defconfig
```kconfig
#
# Copyright (c) 2023 Vincent Nguyen
# SPDX-License-Identifier: MIT
#

CONFIG_ZMK_SPLIT_BLE_CENTRAL_PERIPHERALS=2

CONFIG_SOC_SERIES_NRF52X=y
CONFIG_SOC_NRF52840_QIAA=y
CONFIG_BOARD_ALOIDIA_DONGLE=y
CONFIG_ZMK_SPLIT=y

CONFIG_ZMK_USB=y
CONFIG_ZMK_BLE=y

# Enable MPU

CONFIG_ARM_MPU=y

# # Enable external power control

CONFIG_ZMK_EXT_POWER=y

# Enable GPIO

CONFIG_GPIO=y

# Enable encoders

CONFIG_EC11=y
CONFIG_EC11_TRIGGER_GLOBAL_THREAD=y

# Enable writing to flash

CONFIG_USE_DT_CODE_PARTITION=y
CONFIG_BUILD_OUTPUT_UF2=y

CONFIG_MPU_ALLOW_FLASH_WRITE=y
CONFIG_NVS=y
CONFIG_SETTINGS_NVS=y
CONFIG_FLASH=y
CONFIG_FLASH_PAGE_LAYOUT=y
CONFIG_FLASH_MAP=y

# Enable 32kHz crystal
CONFIG_CLOCK_CONTROL_NRF_K32SRC_XTAL=y
CONFIG_CLOCK_CONTROL_NRF_K32SRC_30PPM=y

# Turn on USB CDC ACM device

CONFIG_USB_DEVICE_STACK=y
CONFIG_USB_CDC_ACM=y
CONFIG_USB_CDC_ACM_RINGBUF_SIZE=1024

# Enable USB logging

CONFIG_ZMK_USB_LOGGING=y
CONFIG_SENSOR_LOG_LEVEL_DBG=y
CONFIG_DISPLAY_LOG_LEVEL_DBG=y
```

## app/boards/arm/aloidia/aloidia_left_defconfig
```kconfig
#
# Copyright (c) 2023 Vincent Nguyen
# SPDX-License-Identifier: MIT
#

CONFIG_SOC_SERIES_NRF52X=y
CONFIG_SOC_NRF52840_QIAA=y
CONFIG_BOARD_ALOIDIA_LEFT=y
CONFIG_ZMK_SPLIT=y
CONFIG_ZMK_SLEEP=y

CONFIG_ZMK_USB=y
CONFIG_ZMK_BLE=y

# Enable MPU
CONFIG_ARM_MPU=y

# Enable external power control
CONFIG_ZMK_EXT_POWER=y

# Enable GPIO
CONFIG_GPIO=y


# Enable I2C
CONFIG_I2C=y
CONFIG_I2C_NRFX=y

CONFIG_MAX17048=y

# Enable SPI
CONFIG_SPI=y
CONFIG_SPI_NRFX=y


# Enable encoders
CONFIG_EC11=y
CONFIG_EC11_TRIGGER_GLOBAL_THREAD=y

# Enable writing to flash

CONFIG_USE_DT_CODE_PARTITION=y
CONFIG_BUILD_OUTPUT_UF2=y

CONFIG_MPU_ALLOW_FLASH_WRITE=y
CONFIG_NVS=y
CONFIG_SETTINGS_NVS=y
CONFIG_FLASH=y
CONFIG_FLASH_PAGE_LAYOUT=y
CONFIG_FLASH_MAP=y

# Enable 32kHz crystal
CONFIG_CLOCK_CONTROL_NRF_K32SRC_XTAL=y
CONFIG_CLOCK_CONTROL_NRF_K32SRC_30PPM=y

# enable display drivers
CONFIG_ZMK_DISPLAY=y
CONFIG_ZMK_DISPLAY_FLIP=y

CONFIG_ZMK_WIDGET_OUTPUT_STATUS=y
CONFIG_ZMK_WIDGET_LAYER_STATUS=y
CONFIG_ZMK_WIDGET_WPM_STATUS=n
CONFIG_ZMK_WIDGET_BATTERY_STATUS=y

CONFIG_ZMK_DISPLAY_STATUS_SCREEN_BUILT_IN=y
CONFIG_ZMK_DISPLAY_STATUS_SCREEN_CUSTOM=n

# CONFIG_ZMK_DISPLAY_WORK_QUEUE_SYSTEM=y
# CONFIG_ZMK_DISPLAY_WORK_QUEUE_DEDICATED=n
CONFIG_ZMK_DISPLAY_WORK_QUEUE_DEDICATED=y
CONFIG_ZMK_DISPLAY_DEDICATED_THREAD_STACK_SIZE=2048

CONFIG_ZMK_KSCAN_DEBOUNCE_PRESS_MS=7
CONFIG_ZMK_KSCAN_DEBOUNCE_RELEASE_MS=7

# CONFIG_IL0323=y
# CONFIG_LVGL_HOR_RES_MAX=80
# CONFIG_LVGL_VER_RES_MAX=128
# CONFIG_LVGL_BITS_PER_PIXEL=1
# CONFIG_LVGL_COLOR_DEPTH_1=y
# CONFIG_LVGL_DPI=145
# CONFIG_LVGL_VDB_SIZE=100
# CONFIG_LVGL_USE_THEME_MONO=y
# CONFIG_LVGL_THEME_DEFAULT_COLOR_PRIMARY_RED=n
# CONFIG_LVGL_THEME_DEFAULT_COLOR_SECONDARY_RED=n
# CONFIG_LVGL_THEME_DEFAULT_COLOR_PRIMARY_BLACK=y
# CONFIG_LVGL_THEME_DEFAULT_COLOR_SECONDARY_WHITE=y
# CONFIG_LVGL_THEME_DEFAULT_FONT_SMALL_MONTSERRAT_16=y
# CONFIG_LVGL_THEME_DEFAULT_FONT_NORMAL_MONTSERRAT_26=y

# # custom status screens
# CONFIG_ZMK_DISPLAY_STATUS_SCREEN_CUSTOM=n
# CONFIG_CUSTOM_WIDGET_BATTERY_STATUS=n
# CONFIG_ZMK_WIDGET_BATTERY_STATUS=y
# CONFIG_CUSTOM_WIDGET_OUTPUT_STATUS=n
# CONFIG_ZMK_WIDGET_OUTPUT_STATUS=n
# CONFIG_CUSTOM_WIDGET_LAYER_STATUS=n
# CONFIG_ZMK_WIDGET_LAYER_STATUS=n
```

## app/boards/arm/aloidia/aloidia_right_defconfig
```kconfig
#
# Copyright (c) 2023 Vincent Nguyen
# SPDX-License-Identifier: MIT
#

CONFIG_SOC_SERIES_NRF52X=y
CONFIG_SOC_NRF52840_QIAA=y
CONFIG_BOARD_ALOIDIA_RIGHT=y
CONFIG_ZMK_SPLIT=y
CONFIG_ZMK_SLEEP=y

CONFIG_ZMK_USB=y
CONFIG_ZMK_BLE=y

# Enable MPU
CONFIG_ARM_MPU=y

# Enable external power control
CONFIG_ZMK_EXT_POWER=y

# Enable GPIO
CONFIG_GPIO=y


# Enable I2C
CONFIG_I2C=y
CONFIG_I2C_NRFX=y

CONFIG_MAX17048=y

# Enable SPI
CONFIG_SPI=y
CONFIG_SPI_NRFX=y


# Enable encoders
CONFIG_EC11=y
CONFIG_EC11_TRIGGER_GLOBAL_THREAD=y

# Enable writing to flash

CONFIG_USE_DT_CODE_PARTITION=y
CONFIG_BUILD_OUTPUT_UF2=y

CONFIG_MPU_ALLOW_FLASH_WRITE=y
CONFIG_NVS=y
CONFIG_SETTINGS_NVS=y
CONFIG_FLASH=y
CONFIG_FLASH_PAGE_LAYOUT=y
CONFIG_FLASH_MAP=y

# Enable 32kHz crystal
CONFIG_CLOCK_CONTROL_NRF_K32SRC_XTAL=y
CONFIG_CLOCK_CONTROL_NRF_K32SRC_30PPM=y

# enable display drivers
CONFIG_ZMK_DISPLAY=y

CONFIG_ZMK_WIDGET_OUTPUT_STATUS=y
CONFIG_ZMK_WIDGET_LAYER_STATUS=y
CONFIG_ZMK_WIDGET_WPM_STATUS=n
CONFIG_ZMK_WIDGET_BATTERY_STATUS=y

CONFIG_ZMK_DISPLAY_STATUS_SCREEN_BUILT_IN=y
CONFIG_ZMK_DISPLAY_STATUS_SCREEN_CUSTOM=n

# CONFIG_ZMK_DISPLAY_WORK_QUEUE_SYSTEM=y
# CONFIG_ZMK_DISPLAY_WORK_QUEUE_DEDICATED=n
CONFIG_ZMK_DISPLAY_WORK_QUEUE_DEDICATED=y
CONFIG_ZMK_DISPLAY_DEDICATED_THREAD_STACK_SIZE=2048

CONFIG_LVGL_THEME_DEFAULT_FONT_SMALL_MONTSERRAT_26=y
CONFIG_LVGL_THEME_DEFAULT_FONT_NORMAL_MONTSERRAT_26=y
CONFIG_ZMK_DISPLAY_BLANK_ON_IDLE=n
```

## app/boards/arm/aloidia_left2/Kconfig.board
```kconfig
# SPDX-License-Identifier: MIT

config BOARD_ALOIDIA_LEFT
	bool "aloidia_left"
	depends on SOC_NRF52840_QIAA
```

## app/boards/arm/aloidia_left2/Kconfig.defconfig
```kconfig
# SPDX-License-Identifier: MIT

if BOARD_ALOIDIA_LEFT

config ZMK_KEYBOARD_NAME
	default "aloidia"

if USB_DEVICE_STACK

config USB_NRFX
	default y

endif # USB_DEVICE_STACK

config BT_CTLR
	default BT

config ZMK_BLE
	default y

config ZMK_USB
	default y

endif # BOARD_ALOIDIA_LEFT
```

## app/boards/shields/aloidia_reset/Kconfig.defconfig
```kconfig
if SHIELD_ALOIDIA_RESET

config ZMK_KEYBOARD_NAME
	default "ALOIDIA RESET"

endif
```

## app/drivers/display/Kconfig.ls0xx_custom
```kconfig
config LS0XX_CUSTOM
bool "LS0XX memory display controller driver"
	depends on SPI
	help
	  Enable driver for sharp memory display series LS0XXX7DXXX
```
